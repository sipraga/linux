## Documentation/devicetree/bindings/a2b/a2b-node.yaml
```yaml
# SPDX-License-Identifier: (GPL-2.0-only OR BSD-2-Clause)
%YAML 1.2
---
$id: http://devicetree.org/schemas/a2b/a2b-node.yaml#
$schema: http://devicetree.org/meta-schemas/core.yaml#

title: Analog Devices Inc. Automotive Audio Bus A2B transceiver node

description: A node on an A2B bus, either in main or subordinate mode.

maintainers:
  - Alvin Šipraga <alsi@bang-olufsen.dk>

allOf:
  - $ref: /schemas/interrupt-controller.yaml#

properties:
  $nodename:
    pattern: "^node@[0-9]+$"

  reg:
    description: The node's address in the A2B bus. Main nodes have address 0.

  interrupts:
    description: The node's interrupt; should be the same as the reg property.

  interrupt-controller: true

  '#interrupt-cells':
    const: 1

patternProperties:
  "^node@[0-9]+$":
    $ref: a2b-node.yaml#
    unevaluatedProperties: false

required:
  - reg
  - interrupts

additionalProperties: true
```

## Documentation/devicetree/bindings/a2b/adi,a2b-audio-graph-card2.yaml
```yaml
# SPDX-License-Identifier: (GPL-2.0-only OR BSD-2-Clause)
%YAML 1.2
---
$id: http://devicetree.org/schemas/a2b/adi,a2b-audio-graph-card2.yaml#
$schema: http://devicetree.org/meta-schemas/core.yaml#

title: Generic A2B sound card

maintainers:
  - Alvin Šipraga <alsi@bang-olufsen.dk>

allOf:
  - $ref: audio-graph-card2.yaml#

properties:
  adi,a2b-bus:
    description: The parent A2B bus of codecs used by this sound card
    $ref: /schemas/types.yaml#/definitions/phandle

  adi,minimum-a2b-nodes:
    description: The minimum number of available A2B nodes required for this
      sound card to be considered operable.
    $ref: /schemas/types.yaml#/definitions/uint32

required:
  - adi,a2b-bus

unevaluatedProperties: false

examples:
  # This sound card can run with or without the last node discovered
  - |
    sound {
      compatible = "adi,a2b-audio-graph-card2";
      adi,a2b-bus = <&a2b>;
      adi,minimum-a2b-nodes = <2>;
      links = <&cpu
               &sound_a2b0_ep
               &sound_a2b1_ep
               &sound_a2b2_ep>;
      widgets = "Speaker", "Speakers";
      ... TODO
    };

    cpu {
      compatible = "cpu-driver"; TODO better name?
    };

    sync_clk: sync-clock {
          compatible = "fixed-clock";
          #clock-cells = <0>;
          clock-frequency = <48000>;
    };

    i2c {
      #address-cells = <1>;
      #size-cells = <0>;

      a2b: a2b@68 {
        compatible = "adi,ad2428";
        reg-names = "base", "bus";
        reg = <0x68>, <0x69>;
        clock-names = "sync";
        clocks = <&sync_clk>;
        #address-cells = <1>;
        #size-cells = <0>;
        interrupts = <42>;
        interrupt-controller;
        #interrupt-cells = <1>;

        node@0 {
          compatible = "adi,ad2428";
          reg = <0>;
          interrupts = <0>;
          adi,tdm-mode = <16>;
          adi,tdm-slot-size = <32>;

          codec {
            compatible = "adi,ad2428-codec";
            #sound-dai-cells = <0>;
            sound-name-prefix = "A2B Main";
          };
        };

        node@1 {
          compatible = "adi,ad2425";
          reg = <1>;
          interrupts = <1>;
          adi,tdm-mode = <8>;
          adi,tdm-slot-size = <32>;

          gpio {
            compatible = "adi,ad2425-gpio";
            interrupt-controller;
            #interrupt-cells = <2>;
            gpio-controller;
            #gpio-cells = <2>;
          };

          codec {
            compatible = "adi,ad2425-codec";
            #sound-dai-cells = <0>;
            sound-name-prefix = "A2B Sub1";
          };

          i2c {
            compatible = "adi,2425-i2c-master";
            #address-cells = <1>;
            #size-cells = <0>;

            eeprom@50 {
              compatible = "atmel,24c64";
              reg = <0x50>;
            };
          };
        };

        node@2 {
          compatible = "adi,ad2425";
          reg = <1>;
          interrupts = <1>;
          adi,tdm-mode = <16>;
          adi,tdm-slot-size = <32>;

          codec {
            compatible = "adi,ad2425-codec";
            #sound-dai-cells = <0>;
            sound-name-prefix = "A2B Sub2";
          };
        };
      };
    };
```

## Documentation/devicetree/bindings/a2b/adi,ad24xx-i2c-master.yaml
```yaml
# SPDX-License-Identifier: (GPL-2.0-only OR BSD-2-Clause)
%YAML 1.2
---
$id: http://devicetree.org/schemas/a2b/adi,ad24xx-i2c-master.yaml#
$schema: http://devicetree.org/meta-schemas/core.yaml#

title: Analog Devices Inc. AD24xx I2C master functional block

maintainers:
  - Alvin Šipraga <alsi@bang-olufsen.dk>

allOf:
  - $ref: /schemas/i2c/i2c-controller.yaml

properties:
  compatible:
    enum:
      - adi,ad2401-i2c-master
      - adi,ad2402-i2c-master
      - adi,ad2403-i2c-master
      - adi,ad2410-i2c-master
      - adi,ad2420-i2c-master
      - adi,ad2421-i2c-master
      - adi,ad2422-i2c-master
      - adi,ad2425-i2c-master
      - adi,ad2426-i2c-master
      - adi,ad2427-i2c-master
      - adi,ad2428-i2c-master

required:
  - compatible

unevaluatedProperties: false

examples:
  - |
    node@1 {
      compatible = "adi,ad2425";
      reg = <1>;
      interrupts = <1>;
      adi,tdm-mode = <16>;
      adi,tdm-slot-size = <32>;

      i2c {
        compatible = "adi,ad2425-i2c-master";
        #address-cells = <1>;
        #size-cells = <0>;
        clock-frequency = <400000>;
      };
    };
```

## Documentation/devicetree/bindings/a2b/adi,ad24xx-node.yaml
```yaml
# SPDX-License-Identifier: (GPL-2.0-only OR BSD-2-Clause)
%YAML 1.2
---
$id: http://devicetree.org/schemas/a2b/adi,ad24xx-node.yaml#
$schema: http://devicetree.org/meta-schemas/core.yaml#

title: Analog Devices Inc. AD24xx A2B node

maintainers:
  - Alvin Šipraga <alsi@bang-olufsen.dk>

allOf:
  - $ref: a2b-node.yaml#

properties:
  compatible:
    enum:
      - adi,ad2401
      - adi,ad2402
      - adi,ad2403
      - adi,ad2410
      - adi,ad2420
      - adi,ad2421
      - adi,ad2422
      - adi,ad2425
      - adi,ad2426
      - adi,ad2427
      - adi,ad2428
      - adi,ad2429
      - beo,shape-node

  gpio:
    $ref: adi,ad24xx-gpio.yaml#

  codec:
    $ref: adi,ad24xx-codec.yaml#

  i2c:
    $ref: adi,ad24xx-i2c-master.yaml#

  clock:
    $ref: adi,ad24xx-clk.yaml#

  adi,tdm-mode:
    enum: [2, 4, 8, 12, 16, 20, 24, 32]

  adi,tdm-slot-size:
    enum: [16, 32]

  adi,invert-sync:
    type: boolean

  adi,early-sync:
    type: boolean

  adi,alternating-sync:
    type: boolean

  adi,rx-on-dtx1:
    type: boolean

  adi,drive-strength:
    description: Configures drive strength low (0) or high (1, default).
    enum: [0, 1]

  adi,invert-interrupt:
    type: boolean

  adi,tristate-interrupt:
    type: boolean

required:
  - compatible
  - adi,tdm-mode
  - adi,tdm-slot-size

unevaluatedProperties: false
```

## Documentation/devicetree/bindings/a2b/adi,ad24xx.yaml
```yaml
# SPDX-License-Identifier: (GPL-2.0-only OR BSD-2-Clause)
%YAML 1.2
---
$id: http://devicetree.org/schemas/a2b/adi,ad24xx.yaml#
$schema: http://devicetree.org/meta-schemas/core.yaml#

title: Analog Devices Inc. AD24xx Automotive Audio Bus A2B Transceiver

description: |
  AD24xx chips provide A2B bus functionality together with several peripheral
  functions, including GPIO, I2S/TDM, an I2C master interface, and programmable
  clock outputs.

maintainers:
  - Alvin Šipraga <alsi@bang-olufsen.dk>

properties:
  compatible:
    enum:
      - adi,ad2403
      - adi,ad2410
      - adi,ad2425
      - adi,ad2428
      - adi,ad2429

  reg-names:
    items:
      - const: base
      - const: bus

  reg:
    items:
      - description: Normal I2C address of the chip
      - description: Auxiliary BUS_ADDR I2C address of the chip

  clock-names:
    items:
      - const: sync

  clocks:
    items:
      - description: SYNC input pin clock source

  vin-supply:
    description: Optional regulator for supply voltage to VIN pin

  bus-supply:
    description: Optional regulator for out-of-band supply voltage to
      subodrinate nodes' VIN pins

  '#address-cells':
    const: 1

  '#size-cells':
    const: 0

  interrupts: true

  interrupt-controller: true

  '#interrupt-cells':
    const: 1

patternProperties:
  "^node@[0-9]+$":
    $ref: a2b-node.yaml#

    unevaluatedProperties: false

required:
  - compatible
  - reg-names
  - reg
  - clock-names
  - clocks
  - '#address-cells'
  - '#size-cells'
  - interrupts
  - interrupt-controller
  - '#interrupt-cells'
  - node@0

unevaluatedProperties: false

examples:
  - |
    sync_clk: sync-clock {
          compatible = "fixed-clock";
          #clock-cells = <0>;
          clock-frequency = <48000>;
    };

    i2c {
      #address-cells = <1>;
      #size-cells = <0>;

      a2b@68 {
        compatible = "adi,ad2428";
        reg-names = "base", "bus";
        reg = <0x68>, <0x69>;
        clock-names = "sync";
        clocks = <&sync_clk>;
        #address-cells = <1>;
        #size-cells = <0>;
        interrupts = <42>;
        interrupt-controller;
        #interrupt-cells = <1>;

        node@0 {
          compatible = "adi,ad2428";
          reg = <0>;
          interrupts = <0>;
          adi,tdm-mode = <16>;
          adi,tdm-slot-size = <32>;

          codec {
            compatible = "adi,ad2428-codec";
            #sound-dai-cells = <0>;
            sound-name-prefix = "A2B Main";
          };
        };

        node@1 {
          compatible = "adi,ad2425";
          reg = <1>;
          interrupts = <1>;
          adi,tdm-mode = <8>;
          adi,tdm-slot-size = <32>;

          gpio {
            compatible = "adi,ad2425-gpio";
            interrupt-controller;
            #interrupt-cells = <2>;
            gpio-controller;
            #gpio-cells = <2>;
          };

          codec {
            compatible = "adi,ad2425-codec";
            #sound-dai-cells = <0>;
            sound-name-prefix = "A2B Sub1";
          };

          i2c {
            compatible = "adi,2425-i2c-master";
            #address-cells = <1>;
            #size-cells = <0>;

            eeprom@50 {
              compatible = "atmel,24c64";
              reg = <0x50>;
            };
          };
        };
      };
    };
```

## drivers/a2b/Kconfig
```kconfig
# SPDX-License-Identifier: GPL-2.0-only

menuconfig A2B
	tristate "Analog Devices A2B Support"
	depends on OF
	select REGMAP_A2B
	help
	  A2B support.

	  If unsure, say no.

if A2B

config A2B_AD24XX
	tristate "AD24XX Support"
	help
	  AD24xx support.

	  If unsure, say no.

config A2B_BEO_SHAPE_NODE
	tristate "Bang & Olufsen Beosound Shape A2B node driver"
	depends on A2B_AD24XX
	help
	  Adds support for the AD2425-based Beosound Shape. The driver handles
	  firmware update of the STM32 MCU on the Shape board. After any
	  firmware update, the driver falls back to the behaviour of the generic
	  driver.

	  If unsure, say no.

endif
```

## sound/soc/adi/Kconfig
```kconfig
# SPDX-License-Identifier: GPL-2.0-only
config SND_SOC_ADI
	tristate "Audio support for Analog Devices reference designs"
	help
	  Audio support for various reference designs by Analog Devices.

config SND_SOC_ADI_AXI_I2S
	tristate "AXI-I2S support"
	depends on SND_SOC_ADI
	select SND_SOC_GENERIC_DMAENGINE_PCM
	select REGMAP_MMIO
	help
	  ASoC driver for the Analog Devices AXI-I2S softcore peripheral.

config SND_SOC_ADI_AXI_SPDIF
	tristate "AXI-SPDIF support"
	depends on SND_SOC_ADI
	select SND_SOC_GENERIC_DMAENGINE_PCM
	select REGMAP_MMIO
	help
	  ASoC driver for the Analog Devices AXI-SPDIF softcore peripheral.

config SND_SOC_A2B_AUDIO_GRAPH_CARD2
       tristate "A2B Audio Graph Card2 driver"
       depends on SND_AUDIO_GRAPH_CARD2
       help
         Generic ASoC driver for sound cards using Analog Devices A2B buses.
	 As well as supporting the same DT bindings as the Audio Graph Card2,
	 the driver supports conditional link and route creation based on the
	 state of the A2B bus after discovery.

	 Say Y or M if you are experimenting with A2B audio and want to build
	 a simple sound card.
```
